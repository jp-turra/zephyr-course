## boards/my_board/board.yml
```yaml
board:
  name: my_board
  full_name: FRDM-MCXN236
  vendor: nxp
  socs:
  - name: mcxn236
```

## boards/other_board/Kconfig.other_board
```kconfig
config BOARD_OTHER_BOARD
	select SOC_MCXN236
	select SOC_PART_NUMBER_MCXN236VDF
	select BOARD_EARLY_INIT_HOOK
```

## boards/other_board/board.yml
```yaml
board:
  name: other_board
  full_name: FRDM-MCXN236
  vendor: nxp
  socs:
  - name: mcxn236
```

## west.yml
```yaml
manifest:
  version: 1.0

  projects:
    - name: zephyr
      url: https://github.com/zephyrproject-rtos/zephyr
      revision: v4.4.2
      import:
        name-allowlist:
          - cmsis_6
          - hal_nxp
          - hal_rpi_pico
          - hal_infineon # Needed for rpi_pico
          - hal_espressif
          - hal_nordic
        path-prefix: deps
```
